## buildroot-ext/Config.in
```kconfig
source "$BR2_EXTERNAL_SSR621Q_FPV_PATH/package/sigmastar-mi/Config.in"
source "$BR2_EXTERNAL_SSR621Q_FPV_PATH/package/gs-tools/Config.in"
source "$BR2_EXTERNAL_SSR621Q_FPV_PATH/package/rtl8812au/Config.in"
source "$BR2_EXTERNAL_SSR621Q_FPV_PATH/package/wfb-ng/Config.in"
```

## buildroot-ext/package/gs-tools/Config.in
```kconfig
config BR2_PACKAGE_GS_TOOLS
	bool "gs-tools"
	select BR2_PACKAGE_SIGMASTAR_MI
	help
	  The ground station's own programs: the video player, the display
	  and framebuffer setup, the adaptive link controller, the wifi
	  monitor-mode helper, and the firmware signature verifier.

	  Built from src/ in this repository.
```

## buildroot-ext/package/rtl8812au/Config.in
```kconfig
config BR2_PACKAGE_RTL8812AU
	bool "rtl8812au (wfb-ng fork)"
	depends on BR2_LINUX_KERNEL
	help
	  Realtek 8812AU driver, wfb-ng fork, providing the monitor-mode and
	  packet-injection behaviour wfb-ng needs. Built out of tree against
	  the kernel buildroot just compiled.
```

## buildroot-ext/package/sigmastar-mi/Config.in
```kconfig
config BR2_PACKAGE_SIGMASTAR_MI
	bool "sigmastar-mi"
	help
	  SigmaStar MI multimedia stack: the kernel modules, the userspace
	  libraries mi-player links, and the /config tree mi_sys reads at
	  init. Prebuilt binaries, taken from the vendor SDK and from a
	  dump of this board's own flash. Nothing here is built from source.
```

## buildroot-ext/package/wfb-ng/Config.in
```kconfig
config BR2_PACKAGE_WFB_NG
	bool "wfb-ng"
	select BR2_PACKAGE_LIBSODIUM
	select BR2_PACKAGE_LIBPCAP
	select BR2_PACKAGE_LIBEVENT
	depends on BR2_INSTALL_LIBSTDCPP
	help
	  wfb-ng receive stack: wfb_rx, wfb_tx, wfb_keygen and wfb_tun.

	  Only the C/C++ binaries are built. Upstream's "all" target also
	  builds a Python service layer and a venv, none of which the ground
	  station uses.

comment "wfb-ng needs a toolchain with C++ support"
	depends on !BR2_INSTALL_LIBSTDCPP
```
